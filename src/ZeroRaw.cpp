#include <Arduino.h>
#include <SerialFlash.h>
#include "ZeroRaw.h"

// Mono PCM16 at 44100 Hz: 261 complete sine periods, 261.6229117 Hz (middle C).
// Endpoints have phase 0 and 261 * 2*pi and are exactly zero; peak amplitude 32767.
const int16_t zeroraw[43996] PROGMEM = {
    0, 1221, 2441, 3657, 4867, 6072, 7267, 8453, 9627, 10787, 11933, 13062,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 -2629,
    -3845, -5055, -6258, -7452, -8636, -9808, -10966, -12109, -13236, -14343, -15431, -16498,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 6444,
    7637, 8819, 9989, 11145, 12285, 13409, 14514, 15598, 16661, 17701, 18717, 19706,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 -10169,
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    -31213, -31563, -31869, -32131, -32348, -32520, -32647, -32729, -32765, -32756, -32701, -32601,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 0
};

static_assert(sizeof(zeroraw) == 87992);

FLASHMEM
bool ZeroRaw_ensure_file(bool require_sine)
{
    SerialFlashFile file = SerialFlash.open("0.raw");
    if (file)
    {
        bool valid = file.size() >= sizeof(int16_t) && file.size() % sizeof(int16_t) == 0;
        if (require_sine)
        {
            valid = file.size() == sizeof(zeroraw);
            const uint8_t *source = reinterpret_cast<const uint8_t *>(zeroraw);
            uint8_t buffer[256];
            for (uint32_t offset = 0; valid && offset < sizeof(zeroraw); offset += sizeof(buffer))
            {
                const uint32_t remaining = sizeof(zeroraw) - offset;
                const uint32_t bytes = remaining < sizeof(buffer) ? remaining : sizeof(buffer);
                valid = file.read(buffer, bytes) == bytes && memcmp(buffer, source + offset, bytes) == 0;
            }
        }
        file.close();
        if (valid)
        {
            return true;
        }
        if (!SerialFlash.remove("0.raw"))
        {
            return false;
        }
    }

    if (!SerialFlash.create("0.raw", sizeof(zeroraw)))
    {
        return false;
    }
    file = SerialFlash.open("0.raw");
    if (!file || file.size() != sizeof(zeroraw))
    {
        file.close();
        SerialFlash.remove("0.raw");
        return false;
    }

    const uint8_t *source = reinterpret_cast<const uint8_t *>(zeroraw);
    constexpr uint32_t block_bytes = 256;
    bool complete = true;

    for (uint32_t offset = 0; offset < sizeof(zeroraw); offset += block_bytes)
    {
        const uint32_t remaining = sizeof(zeroraw) - offset;
        const uint32_t bytes = remaining < block_bytes ? remaining : block_bytes;
        if (file.write(source + offset, bytes) != bytes)
        {
            complete = false;
            break;
        }
        SerialFlash.wait();
    }
    file.close();

    if (!complete)
    {
        SerialFlash.remove("0.raw");
    }
    
    return complete;
}
